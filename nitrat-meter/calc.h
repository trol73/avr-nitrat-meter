/**
 * Вычисляет, на сколько процентов заряжена батарея
 * 		u - напряжение в мВ
 */
uint8_t calcBatteryPercent(uint16_t u) {
	if (u > 415) {
		return 100;
	} else if (u > 380) {
		return (u-380)*25/35 + 75;	// Uбат > 3,8В -> 75...100%
	} else if (u > 360) {
		return (u-360)*50/20+25;	// Uбат > 3,6В - 25...75%
	} else if (u > 300) {
		return (u-300)*25/60;		// Uбат > 3,0В - 0...25%
	}
	return 0;
}

/**
 * Вычисляет уровень заряда батареи 0..5
 * 		u - напряжение в мВ
 */
uint8_t calcBatteryLevel(uint16_t u) {
	if (u > 387) {
		return 5;
	} else if (u > 375) {
		return 4;
	} else if (u > 368) {
		return 3;
	} else if (u > 360) {
		return 2;
	} else if (u > 300) {
		return 1;
	}
	return 0;
}



/*-----Функция вычисления сопротивления продукта в Омах-----*/
uint16_t clk_Rx(uint16_t ADC10) {
/*
        3В*Rи                 3В                    U
  Rx = ------- - Rи;     U = ----- *Rи;      ADC = ----*1024;
          U                  Rx+Rи                 Uref

  Rи=1500 Ом - нижнее плечо делителя, с учетом ||1МОм Rи=1497,75 Ом ~ 1498 Ом;
  3000 мВ - измерительное напряжение;

        3В*Rи*1024          / 3000*1498*1024    ADCx10 + 5 \
  Rx = ------------ - Rи = | ---------------- / ----------- | - 1498
         Uref*ADC           \     Uref             10      /
  */
	if (ADC10 < 180 || ADC10 >= 10230) { //Если ADC10<180 (>98 кОм) или >=10230(<=259 Ом)
		return 0xffff;                             //Установка признака ????
	} else {
		unsigned long r = ((460185600/Uref)*10)/((ADC10+5)/10)-1498;//Rизм=1.5кОм, Nзам=10
		return r > 65535 ? 0xffff : r;
	};
}
//
/*-----Функция вычисления проводимости продукта в мкСм*10-----*/
uint16_t clk_Gx10(uint16_t ADC10) {
/*
        1                    1000000
  Gx = ---- (в См);    Gx = --------- (в мкСм);
        Rx                     Rx
  */
	uint16_t Gx10 = clk_Rx(ADC10);                    //Вычисление Rx
	return Gx10 == 0xffff ? Gx10 : ((100000000/Gx10)+5)/10;
}
