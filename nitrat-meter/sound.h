//звук:
# define SOUND_1 PC1                     //Порт C1 - звук
# define SOUND_2 PC3                     //Порт C3 - звук


void beep (uint8_t a);            //Управление звуком

void tayus (unsigned int t);             //Функция паузы в мкс (12...255)


// Массив данных для формирования звука
const unsigned char PROGMEM massound[8][2]= {
//    n   T				// n - число звуков, T - 1/2 периода
	{ 1, 167 },			// 0 - 1 длинный звук 0,5 сек, 3 кГц	
	{ 1, 167 },			// 1 - 1 короткий звук 0,1 сек, 3 кГц
	{ 2, 167 },			// 2 - 2 коротких звука по 0,1 сек, 3 кГц
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	{ 2, 142 },			// 7 - 2 коротких звука по 0,1 сек, 3,5 кГц
};


//
/*----Функция управления звуком----*/
void beep (uint8_t a) {
/*
Такты :     1     2     1     2     1
         |     |     |     |     |     |
SOUND_1:
          -----       -----       -----
         |     |     |     |     |     |
         |     |     |     |     |     |
         |     |     |     |     |     |
      ---       -----       -----       -----

SOUND_2:
                -----       -----
               |     |     |     |
               |     |     |     |
               |     |     |     |
      ---------       -----       ------------

Разность:
          -----       -----       -----
         |     |     |     |     |     |
         |     |     |     |     |     |
      ---      |     |     |     |      ------
               |     |     |     |
               |     |     |     |
                -----       -----

*/
	if (!sound) {
		return;                  //Если звук отключен - выход из функции
	}
	if (a == 255) {                     //Если нет звука - выход
		return;
	}
	unsigned int Dl=301;                   //Длительность звука t=Dl*0,332мс (301*0,332мс=99,932мс)
	uint8_t n;                       //Количество повторов звука
	unsigned int m=0;                      //Счетчик периодов
	uint8_t T;                       //1/2 периода звуковой частоты в мкс
	if (a == 0) {                     //1 длинный звук 0,5 сек, 3 кГц
		Dl = 1506;
	}
	n = pgm_read_byte(&massound[a][0]);      //Количество повторов звука
	T = pgm_read_byte(&massound[a][1]);      //1/2 периода звуковой частоты в мкс
	cli();                                 //Заперщение прерываний
	while (n != 0) {                           //Цикл из n звуков
		wdt_reset();
		while (m < Dl) {			
			// 1 такт
			PORTC |= _BV(SOUND_1);               //SOUND_1=1
			PORTC &= ~_BV(SOUND_2);              //SOUND_2=0
			tayus(T);                            //Пауза Т (1/2 периода)
			// 2 такт
			PORTC &= ~_BV(SOUND_1);              //SOUND_1=0
			PORTC |= _BV(SOUND_2);               //SOUND_2=1
			
			tayus(T);                          //Пауза Т (1/2 периода)

			m++;
		}
		m = 0;                                 //Сброс счетчика
		n--;
		// Пауза 0,1 сек между звуками
		if (n != 0) {
			_delay_ms(100);
		}
	}
	sei();                                 //Разрешение прерываний
	PORTC &= ~_BV(SOUND_1);                  //SOUND_1=0
	PORTC &= ~_BV(SOUND_2);                  //SOUND_2=0s
	
}
//


/*-----Пауза us-----*/
void tayus (unsigned int tt) {              //t>=7us
	switch (tt) {
		case 142:
			_delay_us(142-2);
			return;
		case 167:
			_delay_us(167-3);
			return;
		case 200:
			_delay_us(200-4);
			return;
			
	}
//	volatile t = tt;
//	if (t > 7) {
//		t -= 7;                               //Коррекция
//		while (t > 3) {
//			t -= 3;
//		}
//		wdt_reset();
//	}
	//  return;                                //Время задержки = t + 0...2 мкс
}